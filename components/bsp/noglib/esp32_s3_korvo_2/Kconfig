## examples/camera_terminal/sdkconfig.defaults.esp32s3
```kconfig
CONFIG_ESP32S3_DEFAULT_CPU_FREQ_240=y
CONFIG_ESP32S3_SPIRAM_SUPPORT=y

CONFIG_CAMERA_MODULE_ESP_S3_EYE=y
CONFIG_ESPTOOLPY_NO_STUB=y
CONFIG_ESP_CONSOLE_USB_SERIAL_JTAG=y
```

## examples/camera_web_server/sdkconfig.defaults
```kconfig
CONFIG_ESPTOOLPY_FLASHSIZE_4MB=y

CONFIG_ESPTOOLPY_FLASHFREQ_80M=y
CONFIG_ESPTOOLPY_FLASHMODE_QIO=y

CONFIG_SPIRAM_SPEED_80M=y

CONFIG_PARTITION_TABLE_CUSTOM=y
CONFIG_PARTITION_TABLE_CUSTOM_FILENAME="partitions.csv"

CONFIG_ESP_TASK_WDT=n

CONFIG_DL_DETECT_ENABLED=y
CONFIG_DL_DETECT_HUMAN_FACE=y
CONFIG_DL_DETECT_HUMAN_FACE_WITH_KEYPOINT=y
CONFIG_DL_RECOGNIZE_HUMAN_FACE=y


# Wait for esp-idf stable
CONFIG_BOOTLOADER_COMPILER_OPTIMIZATION_PERF=y
CONFIG_BOOTLOADER_LOG_LEVEL_NONE=y
CONFIG_SPIRAM_MEMTEST=n
```

## examples/code_recognition/sdkconfig.defaults.esp32s2
```kconfig
CONFIG_ESP32S2_DEFAULT_CPU_FREQ_240=y
CONFIG_ESP32S2_SPIRAM_SUPPORT=y

CONFIG_ESP32S2_DATA_CACHE_16KB=y
ESP32S2_DATA_CACHE_LINE_32B=y

CONFIG_CAMERA_MODULE_ESP_S2_KALUGA=y
CONFIG_LCD_DRIVER_SCREEN_CONTROLLER_ST7789=y
```

## examples/code_recognition/sdkconfig.defaults.esp32s3
```kconfig
CONFIG_ESP32S3_DEFAULT_CPU_FREQ_240=y
CONFIG_ESP32S3_SPIRAM_SUPPORT=y

CONFIG_ESP32S3_DATA_CACHE_64KB=y
CONFIG_ESP32S3_DATA_CACHE_8WAYS=y
CONFIG_ESP32S3_DATA_CACHE_LINE_64B=y

CONFIG_CAMERA_MODULE_ESP_S3_EYE=y
CONFIG_LCD_DRIVER_SCREEN_CONTROLLER_ST7789=y
CONFIG_ESPTOOLPY_NO_STUB=y
CONFIG_ESP_CONSOLE_USB_SERIAL_JTAG=y

CONFIG_SPIRAM_MODE_OCT=y
```
