## components/esp-dl/models/pedestrian_detect/Kconfig
```kconfig
menu "models: pedestrian_detect"
    config PEDESTRIAN_DETECT_PICO_S8_V1
        bool "pedestrian_detect_pico_s8_v1"
        default y

    config PEDESTRIAN_DETECT_MODEL_TYPE
        int
        default 0 if PEDESTRIAN_DETECT_PICO_S8_V1

    choice
        prompt "model location"
        default PEDESTRIAN_DETECT_MODEL_IN_FLASH_RODATA
        help
            pedestrian_detect model location
        config PEDESTRIAN_DETECT_MODEL_IN_FLASH_RODATA
            bool "flash_rodata"
        config PEDESTRIAN_DETECT_MODEL_IN_FLASH_PARTITION
            bool "flash_partition"
        config PEDESTRIAN_DETECT_MODEL_IN_SDCARD
            bool "sdcard"
    endchoice

    config PEDESTRIAN_DETECT_MODEL_LOCATION
        int
        default 0 if PEDESTRIAN_DETECT_MODEL_IN_FLASH_RODATA
        default 1 if PEDESTRIAN_DETECT_MODEL_IN_FLASH_PARTITION
        default 2 if PEDESTRIAN_DETECT_MODEL_IN_SDCARD
endmenu
```

## components/esp32_s3_eye_noglib/Kconfig
```kconfig
menu "Board Support Package"

    config BSP_ERROR_CHECK
        bool "Enable error check in BSP"
        default y
        help
            Error check assert the application before returning the error code.

    menu "I2C"
        config BSP_I2C_NUM
            int "I2C peripheral index"
            default 1
            range 0 1
            help
                ESP32-S3 has two I2C peripherals, pick the one you want to use.

        config BSP_I2C_FAST_MODE
            bool "Enable I2C fast mode"
            default y
            help
                I2C has two speed modes: normal (100kHz) and fast (400kHz).

        config BSP_I2C_CLK_SPEED_HZ
            int
            default 400000 if BSP_I2C_FAST_MODE
            default 100000
    endmenu

    menu "SPIFFS - Virtual File System"
        config BSP_SPIFFS_FORMAT_ON_MOUNT_FAIL
            bool "Format SPIFFS if mounting fails"
            default n
            help
                Format SPIFFS if it fails to mount the filesystem.

        config BSP_SPIFFS_MOUNT_POINT
            string "SPIFFS mount point"
            default "/spiffs"
            help
                Mount point of SPIFFS in the Virtual File System.

        config BSP_SPIFFS_PARTITION_LABEL
            string "Partition label of SPIFFS"
            default "storage"
            help
                Partition label which stores SPIFFS.

        config BSP_SPIFFS_MAX_FILES
            int "Maximum files that could be open at the same time"
            default 2
            help
                Supported max files for SPIFFS in the Virtual File System.
    endmenu

    menu "uSD card - Virtual File System"
        config BSP_SD_FORMAT_ON_MOUNT_FAIL
            bool "Format uSD card if mounting fails"
            default n
            help
                The SDMMC host will format (FAT) the uSD card if it fails to mount the filesystem.

        config BSP_SD_MOUNT_POINT
            string "uSD card mount point"
            default "/sdcard"
            help
                Mount point of the uSD card in the Virtual File System

    endmenu
    menu "Display"
        config BSP_DISPLAY_LVGL_TASK_PRIORITY
            int "LVGL task priority"
            default 2
            help
                The Board Support Package will create a task that will periodically handle LVGL operation in lv_timer_handler().

        config BSP_DISPLAY_LVGL_TICK
            int "LVGL tick period"
            default 5
            range 1 100
            help
                Period of LVGL tick timer.

        config BSP_DISPLAY_LVGL_MAX_SLEEP
            int "LVGL maximum sleep time in ms"
            default 1
            range 1 500
            help
                Maximum time for task sleep in ms.
        
        config BSP_DISPLAY_LVGL_BUFFER_IN_PSRAM
            bool "Allocate LVGL buffer in PSRAM"
            depends on SPI_DMA_SUPPORT_PSRAM
            default n
            help
                LVGL buffer will be allocated in PSRAM instead of internal RAM with DMA.

        config BSP_DISPLAY_BRIGHTNESS_LEDC_CH
            int "LEDC channel index"
            default 1
            range 0 7
            help
                LEDC channel is used to generate PWM signal that controls display brightness.
                Set LEDC index that should be used.
    endmenu

    config BSP_I2S_NUM
        int "I2S peripheral index"
        default 1
        range 0 1
        help
            ESP32-S3 has two I2S peripherals, pick the one you want to use.
endmenu
```

## components/mdns/tests/host_test/main/Kconfig.projbuild
```kconfig
menu "Test Configuration"

    config TEST_HOSTNAME
        string "mDNS Hostname"
        default "esp32-mdns"
        help
            mDNS Hostname for example to use

    config TEST_NETIF_NAME
        string "Network interface name"
        default "eth2"
        help
            Name/ID if the network interface on which we run the mDNS host test

endmenu
```

## components/mdns/tests/host_test/sdkconfig.defaults
```kconfig
CONFIG_IDF_TARGET="linux"
CONFIG_MDNS_NETWORKING_SOCKET=y
CONFIG_MDNS_SKIP_SUPPRESSING_OWN_QUERIES=y
CONFIG_TEST_NETIF_NAME="eth0"
CONFIG_TEST_HOSTNAME="myesp"
CONFIG_MDNS_PREDEF_NETIF_STA=n
CONFIG_MDNS_PREDEF_NETIF_AP=n
CONFIG_MDNS_ENABLE_DEBUG_PRINTS=y
CONFIG_MDNS_RESPOND_REVERSE_QUERIES=y
```

## components/modules/Kconfig
```kconfig
menu "ESP-WHO Configuration"
    
    menu "Wi-Fi Configuration"

        config ESP_HOST_NAME
            string "Camera Host Name"
            default ""
            help
            Hostname that the camera will advertise over mDNS.

        config ESP_WIFI_SSID
            string "WiFi STA SSID"
            default ""
            help
            WiFi SSID (network name) to connect to or empty for Off.

        config ESP_WIFI_PASSWORD
            string "WiFi STA Password"
            default ""
            help
            WiFi Password if WEP/WPA/WPA2 or empty if Open.
            
        config ESP_WIFI_AP_SSID
            string "WiFi AP SSID"
            default "ESP32-Camera"
            help
            AP SSID (network name) to create or empty for Off.

        config ESP_WIFI_AP_PASSWORD
            string "WiFi AP Password"
            default ""
            help
            AP password for WPA2 or empty for Open.

        config MAX_STA_CONN
            int "Maximal STA connections"
            default 1
            help
            Max number of the STA connects to AP.

        config ESP_WIFI_AP_CHANNEL
            string "WiFi AP Channel"
            default ""
            help
            AP channel for better connection performance.

        config SERVER_IP
            string "WiFi AP IP Address"
            default "192.168.4.1"
            help
                IP address that the ESP will assign to it's AP interface. You can use this IP to connect to the camera after flashing.

        config ESP_MAXIMUM_RETRY
            int "Maximum retry"
            default 5
            help
            Set the Maximum retry to avoid station reconnecting to the AP unlimited when the AP is really inexistent.

    endmenu

    menu "Camera Configuration"

        choice CAMERA_MODULE
            bool "Select Camera Pinout"
            default CAMERA_MODULE_WROVER_KIT
            help
                Select Camera Pinout.

            config CAMERA_MODULE_WROVER_KIT
                bool "WROVER-KIT With OV2640 Module"
            config CAMERA_MODULE_ESP_EYE
                bool "ESP-EYE DevKit"
            config CAMERA_MODULE_ESP_S2_KALUGA
                bool "ESP32-S2-Kaluga-1 V1.3"
            config CAMERA_MODULE_ESP_S3_EYE
                bool "ESP-S3-EYE DevKit"
            config CAMERA_MODEL_ESP32_CAM_BOARD
                bool "ESP32 Camera Development Board"
            config CAMERA_MODULE_M5STACK_PSRAM
                bool "M5Stack Camera With PSRAM"
            config CAMERA_MODULE_M5STACK_WIDE
                bool "M5Stack Camera F (Wide)"
            config CAMERA_MODULE_AI_THINKER
                bool "ESP32-CAM by AI-Thinker"
            config CAMERA_MODULE_CUSTOM
                bool "Custom Camera Pinout"
        endchoice

        config CAMERA_PIN_PWDN
            depends on CAMERA_MODULE_CUSTOM
            int "Power Down pin"
            range -1 33
            default -1
            help
                Select Power Down pin or -1 for unmanaged.

        config CAMERA_PIN_RESET
            depends on CAMERA_MODULE_CUSTOM
            int "Reset pin"
            range -1 33
            default -1
            help
                Select Camera Reset pin or -1 for software reset.

        config CAMERA_PIN_XCLK
            depends on CAMERA_MODULE_CUSTOM
            int "XCLK pin"
            range 0 33
            default 21
            help
                Select Camera XCLK pin.

        config CAMERA_PIN_SIOD
            depends on CAMERA_MODULE_CUSTOM
            int "SIOD pin"
            range 0 33
            default 26
            help
                Select Camera SIOD pin.

        config CAMERA_PIN_SIOC
            depends on CAMERA_MODULE_CUSTOM
            int "SIOC pin"
            range 0 33
            default 27
            help
                Select Camera SIOC pin.

        config CAMERA_PIN_VSYNC
            depends on CAMERA_MODULE_CUSTOM
            int "VSYNC pin"
            range 0 39
            default 25
            help
                Select Camera VSYNC pin.

        config CAMERA_PIN_HREF
            depends on CAMERA_MODULE_CUSTOM
            int "HREF pin"
            range 0 39
            default 23
            help
                Select Camera HREF pin.

        config CAMERA_PIN_PCLK
            depends on CAMERA_MODULE_CUSTOM
            int "PCLK pin"
            range 0 39
            default 25
            help
                Select Camera PCLK pin.

        config CAMERA_PIN_Y2
            depends on CAMERA_MODULE_CUSTOM
            int "Y2 pin"
            range 0 39
            default 4
            help
                Select Camera Y2 pin.

        config CAMERA_PIN_Y3
            depends on CAMERA_MODULE_CUSTOM
            int "Y3 pin"
            range 0 39
            default 5
            help
                Select Camera Y3 pin.

        config CAMERA_PIN_Y4
            depends on CAMERA_MODULE_CUSTOM
            int "Y4 pin"
            range 0 39
            default 18
            help
                Select Camera Y4 pin.

        config CAMERA_PIN_Y5
            depends on CAMERA_MODULE_CUSTOM
            int "Y5 pin"
            range 0 39
            default 19
            help
                Select Camera Y5 pin.

        config CAMERA_PIN_Y6
            depends on CAMERA_MODULE_CUSTOM
            int "Y6 pin"
            range 0 39
            default 36
            help
                Select Camera Y6 pin.

        config CAMERA_PIN_Y7
            depends on CAMERA_MODULE_CUSTOM
            int "Y7 pin"
            range 0 39
            default 39
            help
                Select Camera Y7 pin.

        config CAMERA_PIN_Y8
            depends on CAMERA_MODULE_CUSTOM
            int "Y8 pin"
            range 0 39
            default 34
            help
                Select Camera Y8 pin.

        config CAMERA_PIN_Y9
            depends on CAMERA_MODULE_CUSTOM
            int "Y9 pin"
            range 0 39
            default 35
            help
                Select Camera Y9 pin.
    endmenu


    menu "Model Configuration"
        menu "Face Recognition"
            choice FACE_RECOGNITION_MODEL
                bool "Face Recognition Model"
                default MFN_V1
                help
                    Select Face Recognition Model.

                config MFN_V1
                    bool "mfn v1"
    
            endchoice
            
            choice QUANTIZATION
                bool "Quantization"
                default S8
                help
                    Select Face Recognition Model.

                config S8
                    bool "8-bit"
                config S16
                    bool "16-bit"
    
            endchoice
        endmenu

    endmenu

endmenu
```

## components/who_app/who_recognition_app/Kconfig
```kconfig
menu "esp-who: human_face_recognition"
    choice DB_FILE_SYSTEM
        prompt "database file system"
        default DB_FATFS_FLASH
        help
            fatfs support flash/sdcard. spiffs only support flash.
        config DB_FATFS_FLASH
            bool "fatfs_flash"
        config DB_FATFS_SDCARD
            bool "fatfs_sdcard"
        config DB_SPIFFS
            bool "spiffs"
    endchoice
endmenu
```

## components/who_detect/Kconfig
```kconfig
menu "esp-who: detect"
    config USE_PPA_CAM
        bool "Enable PPA to process every cam frame."
        help 
            Use pixel-processing accelerator (PPA) to asynchronously resize the camera frame.
            Hardware resize instead of software resize can reduce the cpu load but it will use
            more psram to store the resized frame.
        default n
endmenu
```

## components/who_peripherals/mcpwm_cxx/Kconfig
```kconfig
menu "esp-who: mcpwm"
    config SERVO_MIN_PULSEWIDTH_US
        int "Servo minimum pulse width in microsecond"
        default 500
    config SERVO_MAX_PULSEWIDTH_US
        int "Servo maximum pulse width in microsecond"
        default 2500
    config SERVO_MIN_DEGREE
        int "Servo minimum angle"
        default -90
    config SERVO_MAX_DEGREE
        int "Servo maximum angle"
        default 90
    config SERVO_TIMEBASE_RESOLUTION_HZ
        int "Servo timebase resolution hz."
        default 1000000
    config SERVO_TIMEBASE_PERIOD
        int "Servo timebase period."
        default 20000
endmenu
```

## components/who_task/Kconfig
```kconfig
menu "esp-who: yield2idle"
    config MAX_TASK_LOOP_TIME
        int "max task loop time in seconds"
        default 1
        help
            This option is related to CONFIG_ESP_TASK_WDT_TIMEOUT_S. If one of your task takes a long time to loop, and the time is close to CONFIG_ESP_TASK_WDT_TIMEOUT_S, try to increase CONFIG_ESP_TASK_WDT_TIMEOUT_S. The value of this option should be round up. For example, real time is 0.3, it should be round up to 1. real time is 1.7, it should be round up to 2.
endmenu
```

## examples/camera_lcd/sdkconfig.defaults
```kconfig
CONFIG_ESP32S3_DEFAULT_CPU_FREQ_240=y
CONFIG_ESP32S3_SPIRAM_SUPPORT=y
CONFIG_SPIRAM_SPEED_80M=y
CONFIG_SPIRAM_MALLOC_ALWAYSINTERNAL=4096
CONFIG_SPIRAM_TRY_ALLOCATE_WIFI_LWIP=y
CONFIG_FREERTOS_HZ=1000

CONFIG_CAMERA_PIXEL_FORMAT_RGB565=y

CONFIG_LCD_DRIVER_SCREEN_CONTROLLER_ILI9341=y
CONFIG_LCD_DRIVER_SCREEN_CONTROLLER_ILI9486=y
CONFIG_LCD_DRIVER_SCREEN_CONTROLLER_ILI9806=y
CONFIG_LCD_DRIVER_SCREEN_CONTROLLER_NT35510=y
CONFIG_LCD_DRIVER_SCREEN_CONTROLLER_RM68120=y
CONFIG_LCD_DRIVER_SCREEN_CONTROLLER_SSD1351=y
CONFIG_LCD_DRIVER_SCREEN_CONTROLLER_ST7789=y
CONFIG_LCD_DRIVER_SCREEN_CONTROLLER_ST7796=y
CONFIG_LCD_DRIVER_SCREEN_CONTROLLER_SSD1306=y
CONFIG_LCD_DRIVER_SCREEN_CONTROLLER_SSD1307=y
CONFIG_LCD_DRIVER_SCREEN_CONTROLLER_SSD1322=y

CONFIG_CAMERA_MODULE_ESP_S3_EYE=y
CONFIG_ESPTOOLPY_NO_STUB=y
CONFIG_ESP_CONSOLE_USB_SERIAL_JTAG=y
CONFIG_SPI_FLASH_USE_LEGACY_IMPL=y
```

## examples/camera_terminal/sdkconfig.defaults
```kconfig
CONFIG_ESPTOOLPY_FLASHSIZE_4MB=y

CONFIG_ESPTOOLPY_FLASHFREQ_80M=y
CONFIG_ESPTOOLPY_FLASHMODE_QIO=y

CONFIG_SPIRAM_SPEED_80M=y

CONFIG_PARTITION_TABLE_CUSTOM=y
CONFIG_PARTITION_TABLE_CUSTOM_FILENAME="partitions.csv"

CONFIG_ESP_TASK_WDT=n


# Wait for esp-idf stable
CONFIG_BOOTLOADER_COMPILER_OPTIMIZATION_PERF=y
CONFIG_BOOTLOADER_LOG_LEVEL_NONE=y
CONFIG_SPIRAM_MEMTEST=n
```

## examples/camera_terminal/sdkconfig.defaults.esp32
```kconfig
CONFIG_ESP32_DEFAULT_CPU_FREQ_240=y
CONFIG_ESP32_SPIRAM_SUPPORT=y

CONFIG_CAMERA_MODULE_ESP_EYE=y
```
