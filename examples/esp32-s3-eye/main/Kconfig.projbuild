## examples/esp32-s3-eye/main/Kconfig.projbuild
```kconfig
menu "ESP32-S3-EYE Firmware"
    choice ESP_SR_LANGUAGE
        bool "esp-sr language"
        default CN_MODEL
        help
             Select ESP-SR Language.
        
        config CN_MODEL
            bool "Chinese"
        config EN_MODEL
            bool "English"
    endchoice
endmenu
```

## examples/esp32-s3-eye/sdkconfig.defaults
```kconfig
# General Configuration
CONFIG_ESPTOOLPY_FLASHSIZE_8MB=y
CONFIG_ESPTOOLPY_FLASHFREQ_80M=y
CONFIG_ESPTOOLPY_FLASHMODE_QIO=y

CONFIG_SPIRAM_SPEED_80M=y
CONFIG_SPIRAM_USE_CAPS_ALLOC=y

CONFIG_ESPTOOLPY_FLASHSIZE_8MB=y
CONFIG_PARTITION_TABLE_CUSTOM=y
CONFIG_PARTITION_TABLE_CUSTOM_FILENAME="partitions.csv"

CONFIG_ESPTOOLPY_NO_STUB=y
CONFIG_ESP_CONSOLE_USB_SERIAL_JTAG=y
CONFIG_SPIRAM_MODE_OCT=y

# ESP32-S3 Configuration
CONFIG_ESP32S3_DEFAULT_CPU_FREQ_240=y
CONFIG_ESP32S3_SPIRAM_SUPPORT=y
CONFIG_ESP32S3_DATA_CACHE_64KB=y
CONFIG_ESP32S3_DATA_CACHE_8WAYS=y
CONFIG_ESP32S3_DATA_CACHE_LINE_64B=y


# Image Relation
CONFIG_CAMERA_MODULE_ESP_S3_EYE=y
CONFIG_LCD_DRIVER_SCREEN_CONTROLLER_ST7789=y
CONFIG_MFN_V1=y
CONFIG_S8=y


# Speech Relation

# Chinese
CONFIG_MODEL_IN_SPIFFS=y
# CONFIG_MODEL_IN_SDCARD is not set
CONFIG_USE_WAKENET=y
CONFIG_SR_WN_WN9_HILEXIN=y

CONFIG_USE_MULTINET=y
CONFIG_SR_MN_CHINESE=y
CONFIG_SR_MN_CN_MULTINET5_RECOGNITION_QUANT8=y
CONFIG_CN_SPEECH_COMMAND_ID0="ting zhi gong zuo"
CONFIG_CN_SPEECH_COMMAND_ID1="jin xian shi"
CONFIG_CN_SPEECH_COMMAND_ID2="ren lian shi bie"
CONFIG_CN_SPEECH_COMMAND_ID3="yi dong zhen ce"
CONFIG_CN_SPEECH_COMMAND_ID4="tian jia ren lian"
CONFIG_CN_SPEECH_COMMAND_ID5="shan chu ren lian"
CONFIG_CN_SPEECH_COMMAND_ID6="shi bie yi xia"
CONFIG_CN_SPEECH_COMMAND_ID7=""
CONFIG_CN_SPEECH_COMMAND_ID8=""
CONFIG_CN_SPEECH_COMMAND_ID9=""
CONFIG_CN_SPEECH_COMMAND_ID10=""
CONFIG_CN_SPEECH_COMMAND_ID11=""
CONFIG_CN_SPEECH_COMMAND_ID12=""
CONFIG_CN_SPEECH_COMMAND_ID13=""
CONFIG_CN_SPEECH_COMMAND_ID14=""
CONFIG_CN_SPEECH_COMMAND_ID15=""
CONFIG_CN_SPEECH_COMMAND_ID16=""
CONFIG_CN_SPEECH_COMMAND_ID17=""
CONFIG_CN_SPEECH_COMMAND_ID18=""
CONFIG_CN_SPEECH_COMMAND_ID19=""

# English
# CONFIG_SR_WN_MODEL_WN8_QUANT8=y
# CONFIG_SR_WN_WN8_HIESP=y
# 
# CONFIG_SR_MN_ENGLISH=y
# CONFIG_SR_MN_EN_MULTINET5_SINGLE_RECOGNITION_QUANT8=y
# CONFIG_EN_SPEECH_COMMAND_ID0="STnP WkKgl"
# CONFIG_EN_SPEECH_COMMAND_ID1="DgSPLd bNLm"
# CONFIG_EN_SPEECH_COMMAND_ID2="FdS RfKcGNgscN"
# CONFIG_EN_SPEECH_COMMAND_ID3="MbscN DgTfKscN"
# CONFIG_EN_SPEECH_COMMAND_ID4="fNTk FdS"
# CONFIG_EN_SPEECH_COMMAND_ID5="DgLmT FdS"
# CONFIG_EN_SPEECH_COMMAND_ID6="RfKcGNiZ FdS"
```

## examples/human_face_recognition/lcd/sdkconfig.defaults
```kconfig
CONFIG_ESPTOOLPY_FLASHSIZE_4MB=y

CONFIG_ESPTOOLPY_FLASHFREQ_80M=y
CONFIG_ESPTOOLPY_FLASHMODE_QIO=y

CONFIG_SPIRAM_SPEED_80M=y
CONFIG_SPIRAM_USE_CAPS_ALLOC=y

CONFIG_PARTITION_TABLE_CUSTOM=y
CONFIG_PARTITION_TABLE_CUSTOM_FILENAME="partitions.csv"

CONFIG_S16=y
CONFIG_ESP_INT_WDT=n
CONFIG_ESP_TASK_WDT=n
```

## examples/human_face_recognition/terminal/sdkconfig.defaults.esp32s2
```kconfig
CONFIG_ESP32S2_DEFAULT_CPU_FREQ_240=y
CONFIG_ESP32S2_SPIRAM_SUPPORT=y

CONFIG_ESP32S2_DATA_CACHE_16KB=y
CONFIG_ESP32S2_DATA_CACHE_LINE_32B=y

CONFIG_CAMERA_MODULE_ESP_S2_KALUGA=y

CONFIG_ESP_INT_WDT=n
CONFIG_ESP_TASK_WDT=n
```

## examples/human_face_recognition_mqtt_simple/main/Kconfig
```kconfig
menu "Application Configuration"

    # config EXAMPLE_BASIC_AUTH
    #     bool "Basic Authentication"
    #     default n
    #     help
    #         Basic Authentication is a method for an HTTP user agent (e.g. a web browser)
    #         to provide a user name and password when making a request. It is the simplest
    #         technique for enforcing access controls to web resources. because it doesn't
    #         require cookies, session identifiers, or login pages; rather, it uses standard
    #         fields in the HTTP header.
    #         Note that, Basic Authentication is not encrypted channel and also easy to retrieve
    #         credentials as they are sent in plain text format.

    # config EXAMPLE_BASIC_AUTH_USERNAME
    #     string "Basic Authenticate User Name"
    #     depends on EXAMPLE_BASIC_AUTH
    #     default "ESP32"
    #     help
    #         The client's user name which used for basic authenticate.

    # config EXAMPLE_BASIC_AUTH_PASSWORD
    #     string "Basic Authenticate Password"
    #     depends on EXAMPLE_BASIC_AUTH
    #     default "ESP32Webserver"
    #     help
    #         The client's password which used for basic authenticate.

    config ESP_WIFI_SSID
        string "WiFi SSID"
        default "CasetaWifi"
        help
            SSID (network name) for the example to connect to.

    config ESP_WIFI_PASSWORD
        string "WiFi Password"
        default "apd14505jc"
        help
            WiFi password (WPA or WPA2) for the example to use.

    choice ESP_WIFI_SAE_MODE
        prompt "WPA3 SAE mode selection"
        default ESP_STATION_EXAMPLE_WPA3_SAE_PWE_BOTH
        help
            Select mode for SAE as Hunt and Peck, H2E or both.
        config ESP_STATION_EXAMPLE_WPA3_SAE_PWE_HUNT_AND_PECK
            bool "HUNT AND PECK"
        config ESP_STATION_EXAMPLE_WPA3_SAE_PWE_HASH_TO_ELEMENT
            bool "H2E"
            depends on ESP_WIFI_ENABLE_SAE_H2E
        config ESP_STATION_EXAMPLE_WPA3_SAE_PWE_BOTH
            bool "BOTH"
            depends on ESP_WIFI_ENABLE_SAE_H2E
    endchoice

    config ESP_WIFI_PW_ID
        string "PASSWORD IDENTIFIER"
        depends on  ESP_STATION_EXAMPLE_WPA3_SAE_PWE_HASH_TO_ELEMENT|| ESP_STATION_EXAMPLE_WPA3_SAE_PWE_BOTH
        default ""
        help
            password identifier for SAE H2E

    config ESP_MAXIMUM_RETRY
        int "Maximum retry"
        default 5
        help
            Set the Maximum retry to avoid station reconnecting to the AP unlimited when the AP is really inexistent.

    choice ESP_WIFI_SCAN_AUTH_MODE_THRESHOLD
        prompt "WiFi Scan auth mode threshold"
        default ESP_WIFI_AUTH_WPA2_PSK
        help
            The weakest authmode to accept in the scan mode.
            This value defaults to ESP_WIFI_AUTH_WPA2_PSK in case password is present and ESP_WIFI_AUTH_OPEN is used.
            Please select ESP_WIFI_AUTH_WEP/ESP_WIFI_AUTH_WPA_PSK in case AP is operating in WEP/WPA mode.

        config ESP_WIFI_AUTH_OPEN
            bool "OPEN"
        config ESP_WIFI_AUTH_WEP
            bool "WEP"
        config ESP_WIFI_AUTH_WPA_PSK
            bool "WPA PSK"
        config ESP_WIFI_AUTH_WPA2_PSK
            bool "WPA2 PSK"
        config ESP_WIFI_AUTH_WPA_WPA2_PSK
            bool "WPA/WPA2 PSK"
        config ESP_WIFI_AUTH_WPA3_PSK
            bool "WPA3 PSK"
        config ESP_WIFI_AUTH_WPA2_WPA3_PSK
            bool "WPA2/WPA3 PSK"
        config ESP_WIFI_AUTH_WAPI_PSK
            bool "WAPI PSK"
    endchoice

    config MQTT_HOST
        string "MQTT_HOST"
        default "mqtt://myhost"
        help
            MQtt host url
    config MQTT_TOPIC_RECOGNITION
        string "MQTT TOPIC_RECOGNITION"
        default "/topic/face/recognized/01"
        help
            Face recognition topic    
    config MQTT_TOPIC_COMMAND
        string "MQTT_TOPIC_COMMAND"
        default "/topic/face/command/01"
        help
            Camera command topic    

    menu "Camera Pins"
        choice CAMERA_MODEL
            bool "Select Camera Pinout"
            default CAMERA_MODEL_WROVER_KIT
            help
                Select Camera Pinout.

        config CAMERA_MODEL_ESP32_S3_CAM
            bool "ESP32-S3-CAM"
        config CAMERA_MODEL_WROVER_KIT
            bool "WROVER-KIT With OV2640 Module"
        config CAMERA_MODEL_ESP32_CAM_BOARD
            bool "ESP32 Camera Development Board"
        config CAMERA_MODEL_ESP_EYE
            bool "ESP_EYE DevKit"
        config CAMERA_MODEL_M5STACK_PSRAM
            bool "M5Stack Camera With PSRAM"
        config CAMERA_MODEL_M5STACK_WIDE
            bool "M5Stack Camera F (Wide)"
        config CAMERA_MODEL_AI_THINKER
            bool "ESP32-CAM by AI-Thinker"
        config CAMERA_MODEL_CUSTOM
            bool "Custom Camera Pinout"
        endchoice

        config CAMERA_PIN_PWDN
            depends on CAMERA_MODEL_CUSTOM
            int "Power Down pin"
            range -1 33
            default -1
            help
                Select Power Down pin or -1 for unmanaged.

        config CAMERA_PIN_RESET
            depends on CAMERA_MODEL_CUSTOM
            int "Reset pin"
            range -1 33
            default -1
            help
                Select Camera Reset pin or -1 for software reset.

        config CAMERA_PIN_XCLK
            depends on CAMERA_MODEL_CUSTOM
            int "XCLK pin"
            range 0 33
            default 21
            help
                Select Camera XCLK pin.

        config CAMERA_PIN_SIOD
            depends on CAMERA_MODEL_CUSTOM
            int "SIOD pin"
            range 0 33
            default 26
            help
                Select Camera SIOD pin.

        config CAMERA_PIN_SIOC
            depends on CAMERA_MODEL_CUSTOM
            int "SIOC pin"
            range 0 33
            default 27
            help
                Select Camera SIOC pin.

        config CAMERA_PIN_VSYNC
            depends on CAMERA_MODEL_CUSTOM
            int "VSYNC pin"
            range 0 39
            default 25
            help
                Select Camera VSYNC pin.

        config CAMERA_PIN_HREF
            depends on CAMERA_MODEL_CUSTOM
            int "HREF pin"
            range 0 39
            default 23
            help
                Select Camera HREF pin.

        config CAMERA_PIN_PCLK
            depends on CAMERA_MODEL_CUSTOM
            int "PCLK pin"
            range 0 39
            default 25
            help
                Select Camera PCLK pin.

        config CAMERA_PIN_Y2
            depends on CAMERA_MODEL_CUSTOM
            int "Y2 pin"
            range 0 39
            default 4
            help
                Select Camera Y2 pin.

        config CAMERA_PIN_Y3
            depends on CAMERA_MODEL_CUSTOM
            int "Y3 pin"
            range 0 39
            default 5
            help
                Select Camera Y3 pin.

        config CAMERA_PIN_Y4
            depends on CAMERA_MODEL_CUSTOM
            int "Y4 pin"
            range 0 39
            default 18
            help
                Select Camera Y4 pin.

        config CAMERA_PIN_Y5
            depends on CAMERA_MODEL_CUSTOM
            int "Y5 pin"
            range 0 39
            default 19
            help
                Select Camera Y5 pin.

        config CAMERA_PIN_Y6
            depends on CAMERA_MODEL_CUSTOM
            int "Y6 pin"
            range 0 39
            default 36
            help
                Select Camera Y6 pin.

        config CAMERA_PIN_Y7
            depends on CAMERA_MODEL_CUSTOM
            int "Y7 pin"
            range 0 39
            default 39
            help
                Select Camera Y7 pin.

        config CAMERA_PIN_Y8
            depends on CAMERA_MODEL_CUSTOM
            int "Y8 pin"
            range 0 39
            default 34
            help
                Select Camera Y8 pin.

        config CAMERA_PIN_Y9
            depends on CAMERA_MODEL_CUSTOM
            int "Y9 pin"
            range 0 39
            default 35
            help
                Select Camera Y9 pin.

    endmenu            

endmenu
```

## examples/motion_detection/web/sdkconfig.defaults
```kconfig
CONFIG_ESPTOOLPY_FLASHSIZE_4MB=y

CONFIG_ESPTOOLPY_FLASHFREQ_80M=y
CONFIG_ESPTOOLPY_FLASHMODE_QIO=y

CONFIG_SPIRAM_SPEED_80M=y

CONFIG_ESP_WIFI_AP_SSID="Motion Detection"

CONFIG_ESP_TASK_WDT=n

# Wait for esp-idf stable
CONFIG_BOOTLOADER_COMPILER_OPTIMIZATION_PERF=y
CONFIG_BOOTLOADER_LOG_LEVEL_NONE=y
CONFIG_SPIRAM_MEMTEST=n
```
