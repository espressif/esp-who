## examples/single_chip/recognition_wechat/sdkconfig.defaults
```kconfig
CONFIG_ESPTOOLPY_PORT="/dev/ttyUSB0"
CONFIG_ESPTOOLPY_BAUD_115200B=
CONFIG_ESPTOOLPY_BAUD_230400B=
CONFIG_ESPTOOLPY_BAUD_921600B=y
CONFIG_ESPTOOLPY_BAUD_2MB=
CONFIG_ESPTOOLPY_BAUD_OTHER=
CONFIG_ESPTOOLPY_BAUD_OTHER_VAL=115200
CONFIG_ESPTOOLPY_BAUD=921600
CONFIG_ESPTOOLPY_COMPRESSED=y
CONFIG_ESPTOOLPY_FLASHMODE_QIO=y
CONFIG_ESPTOOLPY_FLASHMODE_QOUT=
CONFIG_ESPTOOLPY_FLASHMODE_DIO=
CONFIG_ESPTOOLPY_FLASHMODE_DOUT=
CONFIG_ESPTOOLPY_FLASHMODE="dio"
CONFIG_ESPTOOLPY_FLASHFREQ_80M=y
CONFIG_ESPTOOLPY_FLASHFREQ_40M=
CONFIG_ESPTOOLPY_FLASHFREQ_26M=
CONFIG_ESPTOOLPY_FLASHFREQ_20M=
CONFIG_ESPTOOLPY_FLASHFREQ="80m"
CONFIG_ESPTOOLPY_FLASHSIZE_1MB=
CONFIG_ESPTOOLPY_FLASHSIZE_2MB=
CONFIG_ESPTOOLPY_FLASHSIZE_4MB=y
CONFIG_ESPTOOLPY_FLASHSIZE_8MB=
CONFIG_ESPTOOLPY_FLASHSIZE_16MB=
CONFIG_ESPTOOLPY_FLASHSIZE="4MB"
CONFIG_ESPTOOLPY_FLASHSIZE_DETECT=y
CONFIG_ESPTOOLPY_BEFORE_RESET=y
CONFIG_ESPTOOLPY_BEFORE_NORESET=
CONFIG_ESPTOOLPY_BEFORE="default_reset"
CONFIG_ESPTOOLPY_AFTER_RESET=y
CONFIG_ESPTOOLPY_AFTER_NORESET=
CONFIG_ESPTOOLPY_AFTER="hard_reset"
CONFIG_ESPTOOLPY_MONITOR_BAUD_9600B=
CONFIG_ESPTOOLPY_MONITOR_BAUD_57600B=
CONFIG_ESPTOOLPY_MONITOR_BAUD_115200B=y
CONFIG_ESPTOOLPY_MONITOR_BAUD_230400B=
CONFIG_ESPTOOLPY_MONITOR_BAUD_921600B=
CONFIG_ESPTOOLPY_MONITOR_BAUD_2MB=
CONFIG_ESPTOOLPY_MONITOR_BAUD_OTHER=
CONFIG_ESPTOOLPY_MONITOR_BAUD_OTHER_VAL=115200
CONFIG_ESPTOOLPY_MONITOR_BAUD=115200

#
# Partition Table
#
CONFIG_PARTITION_TABLE_SINGLE_APP=
CONFIG_PARTITION_TABLE_TWO_OTA=
CONFIG_PARTITION_TABLE_CUSTOM=y
CONFIG_PARTITION_TABLE_CUSTOM_FILENAME="partitions.csv"
CONFIG_PARTITION_TABLE_FILENAME="partitions.csv"
CONFIG_PARTITION_TABLE_OFFSET=0x8000
CONFIG_PARTITION_TABLE_MD5=y
#
# Camera configuration
#
CONFIG_ENABLE_TEST_PATTERN=
CONFIG_OV2640_SUPPORT=y
CONFIG_OV7725_SUPPORT=

#
# ESP32-specific
#
CONFIG_ESP32_DEFAULT_CPU_FREQ_80=
CONFIG_ESP32_DEFAULT_CPU_FREQ_160=
CONFIG_ESP32_DEFAULT_CPU_FREQ_240=y
CONFIG_ESP32_DEFAULT_CPU_FREQ_MHZ=240
CONFIG_ESP32_SPIRAM_SUPPORT=y

#
# SPI RAM config
#
CONFIG_ESP32_SPIRAM_BOOT_INIT=y
CONFIG_ESP32_SPIRAM_IGNORE_NOTFOUND=
CONFIG_ESP32_SPIRAM_USE_MEMMAP=
CONFIG_ESP32_SPIRAM_USE_CAPS_ALLOC=
CONFIG_ESP32_SPIRAM_USE_MALLOC=y
CONFIG_ESP32_SPIRAM_TYPE_AUTO=y
CONFIG_ESP32_SPIRAM_TYPE_ESPPSRAM32=
CONFIG_ESP32_SPIRAM_TYPE_ESPPSRAM64=
CONFIG_ESP32_SPIRAM_SIZE=-1
CONFIG_ESP32_SPIRAM_SPEED_40M=
CONFIG_ESP32_SPIRAM_SPEED_80M=y
CONFIG_ESP32_SPIRAM_MEMTEST=y
CONFIG_ESP32_SPIRAM_CACHE_WORKAROUND=y
CONFIG_ESP32_SPIRAM_BANKSWITCH_ENABLE=y
CONFIG_ESP32_SPIRAM_BANKSWITCH_RESERVE=8
CONFIG_ESP32_SPIRAM_MALLOC_ALWAYSINTERNAL=3096
CONFIG_SPIRAM_TRY_ALLOCATE_WIFI_LWIP=
CONFIG_SPIRAM_MALLOC_RESERVE_INTERNAL=32768
CONFIG_SPIRAM_ALLOW_STACK_EXTERNAL_MEMORY=
CONFIG_SPIRAM_ALLOW_BSS_SEG_EXTERNAL_MEMORY=
CONFIG_SPIRAM_OCCUPY_HSPI_HOST=
CONFIG_SPIRAM_OCCUPY_VSPI_HOST=y

CONFIG_TASK_WDT=
CONFIG_BT_ENABLED=y
```

## examples/test/sdkconfig.defaults.esp32s2
```kconfig
CONFIG_ESP32S2_DEFAULT_CPU_FREQ_240=y
CONFIG_ESP32S2_SPIRAM_SUPPORT=y

CONFIG_ESP32S2_DATA_CACHE_64KB=y
CONFIG_ESP32S2_DATA_CACHE_8WAYS=y
CONFIG_ESP32S2_DATA_CACHE_LINE_64B=y

CONFIG_CAMERA_MODULE_ESP_S2_KALUGA=y
CONFIG_LCD_DRIVER_SCREEN_CONTROLLER_ST7789=y
```
