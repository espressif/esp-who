## examples/object_tracking/main/Kconfig.projbuild
```kconfig
menu "Servo Configuration"

    menu "Pan Servo Configuration"
        config PAN_GPIO
            int "Pan Servo GPIO"
            default 5
            help
                GPIO number for pan servo control.

        choice PAN_DIRECTION
            prompt "Pan Servo Direction"
            default PAN_DIRECTION_FORWARD
            help
                Pan servo rotation direction.

            config PAN_DIRECTION_FORWARD
                bool "Forward"
            config PAN_DIRECTION_REVERSE
                bool "Reverse"
        endchoice

        config PAN_DIR
            int
            default 1 if PAN_DIRECTION_FORWARD
            default -1 if PAN_DIRECTION_REVERSE

        config PAN_KP
            string "Pan PID Kp"
            default "0.25"
            help
                Pan servo PID proportional gain.

        config PAN_KI
            string "Pan PID Ki"
            default "0.0"
            help
                Pan servo PID integral gain.

        config PAN_KD
            string "Pan PID Kd"
            default "0.0"
            help
                Pan servo PID derivative gain.

        config PAN_INIT_ANGLE
            int "Pan Initial Angle"
            default 0
            help
                Pan servo initial angle in degrees.

        config PAN_MIN_ANGLE
            int "Pan Minimum Angle"
            default -90
            help
                Pan servo minimum angle in degrees.

        config PAN_MAX_ANGLE
            int "Pan Maximum Angle"
            default 90
            help
                Pan servo maximum angle in degrees.
    endmenu

    menu "Tilt Servo Configuration"
        config TILT_GPIO
            int "Tilt Servo GPIO"
            default 6
            help
                GPIO number for tilt servo control.

        choice TILT_DIRECTION
            prompt "Tilt Servo Direction"
            default TILT_DIRECTION_FORWARD
            help
                Tilt servo rotation direction.

            config TILT_DIRECTION_FORWARD
                bool "Forward"
            config TILT_DIRECTION_REVERSE
                bool "Reverse"
        endchoice

        config TILT_DIR
            int
            default 1 if TILT_DIRECTION_FORWARD
            default -1 if TILT_DIRECTION_REVERSE

        config TILT_KP
            string "Tilt PID Kp"
            default "0.2"
            help
                Tilt servo PID proportional gain.

        config TILT_KI
            string "Tilt PID Ki"
            default "0.0"
            help
                Tilt servo PID integral gain.

        config TILT_KD
            string "Tilt PID Kd"
            default "0.0"
            help
                Tilt servo PID derivative gain.

        config TILT_INIT_ANGLE
            int "Tilt Initial Angle"
            default 0
            help
                Tilt servo initial angle in degrees.

        config TILT_MIN_ANGLE
            int "Tilt Minimum Angle"
            default -90
            help
                Tilt servo minimum angle in degrees.

        config TILT_MAX_ANGLE
            int "Tilt Maximum Angle"
            default 90
            help
                Tilt servo maximum angle in degrees.
    endmenu

    menu "Camera Configuration"
        config CAMERA_WIDTH
            int "Camera Capture Width"
            default 640
            help
                UVC camera capture width in pixels.

        config CAMERA_HEIGHT
            int "Camera Capture Height"
            default 480
            help
                UVC camera capture height in pixels.

        config CAMERA_FPS
            string "Camera FPS"
            default "30"
            help
                UVC camera frames per second.

        config DISPLAY_WIDTH
            int "Display Width"
            default 800
            help
                Display width after resize in pixels.

        config DISPLAY_HEIGHT
            int "Display Height"
            default 600
            help
                Display height after resize in pixels.

        config CAMERA_FX
            string "Camera Focal Length X (fx)"
            default "266"
            help
                Camera intrinsic parameter fx (focal length in x direction).

        config CAMERA_FY
            string "Camera Focal Length Y (fy)"
            default "266"
            help
                Camera intrinsic parameter fy (focal length in y direction).

    endmenu

endmenu
```

## examples/single_chip/color_detection_web/main/Kconfig.projbuild
```kconfig
menu "Camera Web Server"

menu "WiFi Settings"
config ESP_HOST_NAME
    string "Camera Host Name"
    default ""
    help
    Hostname that the camera will advertise over mDNS.

config ESP_WIFI_SSID
    string "WiFi STA SSID"
    default ""
    help
    WiFi SSID (network name) to connect to or empty for Off.

config ESP_WIFI_PASSWORD
    string "WiFi STA Password"
    default ""
    help
    WiFi Password if WEP/WPA/WPA2 or empty if Open.
    
config ESP_WIFI_AP_SSID
    string "WiFi AP SSID"
    default "ESP32-Camera"
    help
	AP SSID (network name) to create or empty for Off.

config ESP_WIFI_AP_PASSWORD
    string "WiFi AP Password"
    default ""
    help
	AP password for WPA2 or empty for Open.

config MAX_STA_CONN
    int "Maximal STA connections"
    default 1
    help
	Max number of the STA connects to AP.

config ESP_WIFI_AP_CHANNEL
    string "WiFi AP Channel"
    default ""
    help
	AP channel for better connection performance.

config SERVER_IP
    string "WiFi AP IP Address"
    default "192.168.4.1"
    help
        IP address that the ESP will assign to it's AP interface. You can use this IP to connect to the camera after flashing.

config ESP_MAXIMUM_RETRY
    int "Maximum retry"
    default 5
    help
    Set the Maximum retry to avoid station reconnecting to the AP unlimited when the AP is really inexistent.
endmenu

menu "LED Illuminator"
config LED_ILLUMINATOR_ENABLED
    bool "LED Illuminator Enabled"
    default n
    help
    Enable an LED Flash or IR Illuminator

config LED_LEDC_PIN
    depends on LED_ILLUMINATOR_ENABLED
    int "LED Illuminator GPIO Pin"
    range 0 33
    default 4
    help
    Set a pin to illuminate an onboard LED or IR Illuminator when streaming or taking snapshots.

config LED_MAX_INTENSITY
    depends on LED_ILLUMINATOR_ENABLED
    int "LED Maximum Intensity (0-255)"
    range 0 255
    default 255
    help
    Limit the maximum intensity of the LED while streaming to prevent overheating (0-255).

choice LED_LEDC_SPEED_MODE
    depends on LED_ILLUMINATOR_ENABLED
    bool "Select LEDC Timer Speed Mode"
    default LED_LEDC_LOW_SPEED_MODE
    help
    Select a speed mode for the LEDC channel 

config LED_LEDC_LOW_SPEED_MODE  
    bool "LOW_SPEED_MODE"
config LED_LEDC_HIGH_SPEED_MODE
    bool "HIGH_SPEED_MODE"
endchoice

config LED_LEDC_TIMER
    depends on LED_ILLUMINATOR_ENABLED
    int "LEDC Timer"
    range 0 3
    default 1
    help
    Select the LEDC Timer (0-3)

config LED_LEDC_CHANNEL
    depends on LED_ILLUMINATOR_ENABLED
    int "LEDC Channel"
    range 0 7
    default 1
    help
    Select the LEDC Channel (0-7)
endmenu

menu "Camera Pins"
choice CAMERA_MODEL
    bool "Select Camera Pinout"
    default CAMERA_MODEL_WROVER_KIT
    help
        Select Camera Pinout.

config CAMERA_MODEL_WROVER_KIT
    bool "WROVER-KIT With OV2640 Module"
config CAMERA_MODEL_ESP32_CAM_BOARD
    bool "ESP32 Camera Development Board"
config CAMERA_MODEL_ESP_EYE
    bool "ESP_EYE DevKit"
config CAMERA_MODEL_M5STACK_PSRAM
    bool "M5Stack Camera With PSRAM"
config CAMERA_MODEL_M5STACK_WIDE
    bool "M5Stack Camera F (Wide)"
config CAMERA_MODEL_AI_THINKER
    bool "ESP32-CAM by AI-Thinker"
config CAMERA_MODEL_CUSTOM
    bool "Custom Camera Pinout"
endchoice

config CAMERA_PIN_PWDN
    depends on CAMERA_MODEL_CUSTOM
    int "Power Down pin"
    range -1 33
    default -1
    help
        Select Power Down pin or -1 for unmanaged.

config CAMERA_PIN_RESET
    depends on CAMERA_MODEL_CUSTOM
    int "Reset pin"
    range -1 33
    default -1
    help
        Select Camera Reset pin or -1 for software reset.

config CAMERA_PIN_XCLK
    depends on CAMERA_MODEL_CUSTOM
    int "XCLK pin"
    range 0 33
    default 21
    help
        Select Camera XCLK pin.

config CAMERA_PIN_SIOD
    depends on CAMERA_MODEL_CUSTOM
    int "SIOD pin"
    range 0 33
    default 26
    help
        Select Camera SIOD pin.

config CAMERA_PIN_SIOC
    depends on CAMERA_MODEL_CUSTOM
    int "SIOC pin"
    range 0 33
    default 27
    help
        Select Camera SIOC pin.

config CAMERA_PIN_VSYNC
    depends on CAMERA_MODEL_CUSTOM
    int "VSYNC pin"
    range 0 39
    default 25
    help
        Select Camera VSYNC pin.

config CAMERA_PIN_HREF
    depends on CAMERA_MODEL_CUSTOM
    int "HREF pin"
    range 0 39
    default 23
    help
        Select Camera HREF pin.

config CAMERA_PIN_PCLK
    depends on CAMERA_MODEL_CUSTOM
    int "PCLK pin"
    range 0 39
    default 25
    help
        Select Camera PCLK pin.

config CAMERA_PIN_Y2
    depends on CAMERA_MODEL_CUSTOM
    int "Y2 pin"
    range 0 39
    default 4
    help
        Select Camera Y2 pin.

config CAMERA_PIN_Y3
    depends on CAMERA_MODEL_CUSTOM
    int "Y3 pin"
    range 0 39
    default 5
    help
        Select Camera Y3 pin.

config CAMERA_PIN_Y4
    depends on CAMERA_MODEL_CUSTOM
    int "Y4 pin"
    range 0 39
    default 18
    help
        Select Camera Y4 pin.

config CAMERA_PIN_Y5
    depends on CAMERA_MODEL_CUSTOM
    int "Y5 pin"
    range 0 39
    default 19
    help
        Select Camera Y5 pin.

config CAMERA_PIN_Y6
    depends on CAMERA_MODEL_CUSTOM
    int "Y6 pin"
    range 0 39
    default 36
    help
        Select Camera Y6 pin.

config CAMERA_PIN_Y7
    depends on CAMERA_MODEL_CUSTOM
    int "Y7 pin"
    range 0 39
    default 39
    help
        Select Camera Y7 pin.

config CAMERA_PIN_Y8
    depends on CAMERA_MODEL_CUSTOM
    int "Y8 pin"
    range 0 39
    default 34
    help
        Select Camera Y8 pin.

config CAMERA_PIN_Y9
    depends on CAMERA_MODEL_CUSTOM
    int "Y9 pin"
    range 0 39
    default 35
    help
        Select Camera Y9 pin.

endmenu

endmenu
```

## examples/single_chip/detection_with_command_line/sdkconfig.defaults
```kconfig
CONFIG_ESPTOOLPY_PORT="/dev/ttyUSB1"
CONFIG_ESPTOOLPY_BAUD_115200B=
CONFIG_ESPTOOLPY_BAUD_230400B=
CONFIG_ESPTOOLPY_BAUD_921600B=y
CONFIG_ESPTOOLPY_BAUD_2MB=
CONFIG_ESPTOOLPY_BAUD_OTHER=
CONFIG_ESPTOOLPY_BAUD_OTHER_VAL=115200
CONFIG_ESPTOOLPY_BAUD=921600
CONFIG_ESPTOOLPY_COMPRESSED=y
CONFIG_FLASHMODE_QIO=y
CONFIG_FLASHMODE_QOUT=
CONFIG_FLASHMODE_DIO=
CONFIG_FLASHMODE_DOUT=
CONFIG_ESPTOOLPY_FLASHMODE="dio"
CONFIG_ESPTOOLPY_FLASHFREQ_80M=y
CONFIG_ESPTOOLPY_FLASHFREQ_40M=
CONFIG_ESPTOOLPY_FLASHFREQ_26M=
CONFIG_ESPTOOLPY_FLASHFREQ_20M=
CONFIG_ESPTOOLPY_FLASHFREQ="80m"
CONFIG_ESPTOOLPY_FLASHSIZE_1MB=
CONFIG_ESPTOOLPY_FLASHSIZE_2MB=
CONFIG_ESPTOOLPY_FLASHSIZE_4MB=y
CONFIG_ESPTOOLPY_FLASHSIZE_8MB=
CONFIG_ESPTOOLPY_FLASHSIZE_16MB=
CONFIG_ESPTOOLPY_FLASHSIZE="4MB"
CONFIG_ESPTOOLPY_FLASHSIZE_DETECT=y
CONFIG_ESPTOOLPY_BEFORE_RESET=y
CONFIG_ESPTOOLPY_BEFORE_NORESET=
CONFIG_ESPTOOLPY_BEFORE="default_reset"
CONFIG_ESPTOOLPY_AFTER_RESET=y
CONFIG_ESPTOOLPY_AFTER_NORESET=
CONFIG_ESPTOOLPY_AFTER="hard_reset"
CONFIG_MONITOR_BAUD_9600B=
CONFIG_MONITOR_BAUD_57600B=
CONFIG_MONITOR_BAUD_115200B=y
CONFIG_MONITOR_BAUD_230400B=
CONFIG_MONITOR_BAUD_921600B=
CONFIG_MONITOR_BAUD_2MB=
CONFIG_MONITOR_BAUD_OTHER=
CONFIG_MONITOR_BAUD_OTHER_VAL=115200
CONFIG_MONITOR_BAUD=115200

#
# Partition Table
#
CONFIG_PARTITION_TABLE_SINGLE_APP=
CONFIG_PARTITION_TABLE_TWO_OTA=
CONFIG_PARTITION_TABLE_CUSTOM=y
CONFIG_PARTITION_TABLE_CUSTOM_FILENAME="partitions.csv"
CONFIG_PARTITION_TABLE_FILENAME="partitions.csv"
CONFIG_PARTITION_TABLE_OFFSET=0x8000
CONFIG_PARTITION_TABLE_MD5=y
#
# Camera configuration
#
CONFIG_ENABLE_TEST_PATTERN=
CONFIG_OV2640_SUPPORT=y
CONFIG_OV7725_SUPPORT=

#
# ESP32-specific
#
CONFIG_ESP32_DEFAULT_CPU_FREQ_80=
CONFIG_ESP32_DEFAULT_CPU_FREQ_160=
CONFIG_ESP32_DEFAULT_CPU_FREQ_240=y
CONFIG_ESP32_DEFAULT_CPU_FREQ_MHZ=240
CONFIG_SPIRAM_SUPPORT=y

#
# SPI RAM config
#
CONFIG_SPIRAM_BOOT_INIT=y
CONFIG_SPIRAM_IGNORE_NOTFOUND=
CONFIG_SPIRAM_USE_MEMMAP=
CONFIG_SPIRAM_USE_CAPS_ALLOC=
CONFIG_SPIRAM_USE_MALLOC=y
CONFIG_SPIRAM_TYPE_AUTO=
CONFIG_SPIRAM_TYPE_ESPPSRAM32=y
CONFIG_SPIRAM_TYPE_ESPPSRAM64=
CONFIG_SPIRAM_SIZE=4194304
CONFIG_SPIRAM_SPEED_40M=
CONFIG_SPIRAM_SPEED_80M=y
CONFIG_SPIRAM_MEMTEST=y
CONFIG_SPIRAM_CACHE_WORKAROUND=y
CONFIG_SPIRAM_BANKSWITCH_ENABLE=y
CONFIG_SPIRAM_BANKSWITCH_RESERVE=8
CONFIG_SPIRAM_MALLOC_ALWAYSINTERNAL=16384
CONFIG_WIFI_LWIP_ALLOCATION_FROM_SPIRAM_FIRST=
CONFIG_SPIRAM_MALLOC_RESERVE_INTERNAL=32768
CONFIG_SPIRAM_ALLOW_STACK_EXTERNAL_MEMORY=
CONFIG_SPIRAM_ALLOW_BSS_SEG_EXTERNAL_MEMORY=

CONFIG_TASK_WDT=
```

## examples/single_chip/lcd_cam_loopback/components/esp-face/Kconfig
```kconfig
choice CONV_IMPL
    bool "Convolution Implementation"
    default XTENSA_IMPL
      
config C_IMPL
	bool "ANSI Implementation for general platforms"

config XTENSA_IMPL
	bool "Xtensa Implementation for ESP"

config TIE_IMPL
	bool "TIE Implementation for ESP"
	
endchoice



menu "ESP-FACE Configuration"

    choice DETECTION_MODEL
        bool "Detection Model"
        default MTMN_LITE_QUANT

        config MTMN_LITE_QUANT
            bool "MTMN lite in quantization"
        
        config MTMN_LITE_FLOAT
            bool "MTMN lite in float"

        config MTMN_HEAVY_QUANT
            bool "MTMN heavy in quantization"
    endchoice

    choice RECOGNITION_MODEL
        bool "Recognition Model"
        default MFN56_1X
        config FRMN
            bool "FRMN"
        config MFN56_1X
            bool "MFN56_1X"
        config MFN56_2X
            bool "MFN56_2X"
        config MFN56_3X
            bool "MFN56_3X"
        config MFN56_4X
            bool "MFN56_4X"
    endchoice

    menu "Object Detection"
    
        choice OBJECT_DETECTION_MODEL
            bool "Model"
            default LSSH_SPARSE_MN_5

            config LSSH_SPARSE_MN_5
                bool "LSSH SPARSE MN 5"
        endchoice

        config LSSH_WITH_LANDMARK
            bool "With landmark"
            default n

    endmenu

endmenu
```

## examples/single_chip/recognition_solution_with_test/main/Kconfig.projbuild
```kconfig
menu "Example Configuration"

config ESP_WIFI_SSID
    string "WiFi SSID"
    default ""
    help
	SSID (network name) for the example to connect to.

config ESP_WIFI_PASSWORD
    string "WiFi Password"
    default ""
    help
	WiFi password (WPA or WPA2) for the example to use.

config MAX_STA_CONN
    int "Maximal STA connections"
    default 1
    help
	Max number of the STA connects to AP.

config ESP_WIFI_AP_CHANNEL
    string "WiFi AP Channel"
    default ""
    help
	AP channel for better connection performance.

config SERVER_IP
    string "IP address of server"
    default "192.168.4.1"
endmenu
```
