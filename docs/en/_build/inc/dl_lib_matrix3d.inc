.. File automatically generated by 'gen-dxd.py'

Header File
^^^^^^^^^^^

* :component_file:`esp-face/lib/include/dl_lib_matrix3d.h`

Functions
^^^^^^^^^

.. doxygenfunction:: dl_lib_calloc
.. doxygenfunction:: dl_lib_free
.. doxygenfunction:: dl_matrix3d_alloc
.. doxygenfunction:: dl_matrix3du_alloc
.. doxygenfunction:: dl_matrix3d_free
.. doxygenfunction:: dl_matrix3du_free
.. doxygenfunction:: dl_matrix3dff_dot_product
.. doxygenfunction:: dl_matrix3d_softmax
.. doxygenfunction:: dl_matrix3d_slice_copy
.. doxygenfunction:: dl_matrix3du_slice_copy
.. doxygenfunction:: dl_matrix3d_sliced_transform_nchw
.. doxygenfunction:: dl_matrix3d_conv
.. doxygenfunction:: dl_matrix3d_global_pool
.. doxygenfunction:: dl_matrix3d_pooling
.. doxygenfunction:: dl_matrix3d_batch_normalize
.. doxygenfunction:: dl_matrix3d_add
.. doxygenfunction:: dl_matrix3d_concat
.. doxygenfunction:: dl_matrix3d_concat_4
.. doxygenfunction:: dl_matrix3d_concat_8
.. doxygenfunction:: dl_matrix3d_mobilefaceblock
.. doxygenfunction:: dl_matrix3d_mobilefaceblock_split
.. doxygenfunction:: dl_matrix3d_init_bias
.. doxygenfunction:: dl_matrix3d_multiply
.. doxygenfunction:: dl_matrix3d_relu
.. doxygenfunction:: dl_matrix3d_relu_clip
.. doxygenfunction:: dl_matrix3d_p_relu
.. doxygenfunction:: dl_matrix3d_leaky_relu
.. doxygenfunction:: dl_matrix3dff_conv_1x1
.. doxygenfunction:: dl_matrix3dff_conv_1x1_with_bias
.. doxygenfunction:: dl_matrix3duf_conv_1x1
.. doxygenfunction:: dl_matrix3duf_conv_1x1_with_bias
.. doxygenfunction:: dl_matrix3dff_conv_3x3_op
.. doxygenfunction:: dl_matrix3dff_conv_3x3
.. doxygenfunction:: dl_matrix3duf_conv_common
.. doxygenfunction:: dl_matrix3dff_conv_common
.. doxygenfunction:: dl_matrix3dff_depthwise_conv_3x3
.. doxygenfunction:: dl_matrix3duf_depthwise_conv_3x3
.. doxygenfunction:: dl_matrix3dff_depthwise_conv_3x3_op
.. doxygenfunction:: dl_matrix3dff_depthwise_conv_common
.. doxygenfunction:: dl_matrix3dff_fc
.. doxygenfunction:: dl_matrix3dff_fc_with_bias
.. doxygenfunction:: dl_matrix3dff_mobilenet
.. doxygenfunction:: dl_matrix3duf_mobilenet

Structures
^^^^^^^^^^

.. doxygenstruct:: dl_matrix3d_t
    :members:

.. doxygenstruct:: dl_matrix3du_t
    :members:

.. doxygenstruct:: dl_matrix3d_mobilenet_config_t
    :members:


Macros
^^^^^^

.. doxygendefine:: DL_SPIRAM_SUPPORT
.. doxygendefine:: max
.. doxygendefine:: min

Type Definitions
^^^^^^^^^^^^^^^^

.. doxygentypedef:: fptp_t
.. doxygentypedef:: uc_t

Enumerations
^^^^^^^^^^^^

.. doxygenenum:: dl_error_type
.. doxygenenum:: dl_padding_type
.. doxygenenum:: dl_pooling_type
.. doxygenenum:: dl_upsample_type

