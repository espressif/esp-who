.. File automatically generated by 'gen-dxd.py'

Header File
^^^^^^^^^^^

* :component_file:`esp-face/face_recognition/include/fr_forward.h`

Functions
^^^^^^^^^

.. doxygenfunction:: align_face_rot
.. doxygenfunction:: align_face_sim
.. doxygenfunction:: align_face
.. doxygenfunction:: face_id_init
.. doxygenfunction:: face_id_name_init
.. doxygenfunction:: aligned_face_alloc
.. doxygenfunction:: get_face_id
.. doxygenfunction:: add_face_id
.. doxygenfunction:: recognize_face
.. doxygenfunction:: recognize_face_with_name
.. doxygenfunction:: enroll_face
.. doxygenfunction:: enroll_face_with_name
.. doxygenfunction:: delete_face
.. doxygenfunction:: delete_face_with_name
.. doxygenfunction:: delete_face_all_with_name

Structures
^^^^^^^^^^

.. doxygenstruct:: tag_face_id_node
    :members:

.. doxygenstruct:: face_id_name_list
    :members:

.. doxygenstruct:: face_id_list
    :members:


Macros
^^^^^^

.. doxygendefine:: FACE_WIDTH
.. doxygendefine:: FACE_HEIGHT
.. doxygendefine:: FACE_ID_SIZE
.. doxygendefine:: FACE_REC_THRESHOLD
.. doxygendefine:: LEFT_EYE_X
.. doxygendefine:: LEFT_EYE_Y
.. doxygendefine:: RIGHT_EYE_X
.. doxygendefine:: RIGHT_EYE_Y
.. doxygendefine:: NOSE_X
.. doxygendefine:: NOSE_Y
.. doxygendefine:: LEFT_MOUTH_X
.. doxygendefine:: LEFT_MOUTH_Y
.. doxygendefine:: RIGHT_MOUTH_X
.. doxygendefine:: RIGHT_MOUTH_Y
.. doxygendefine:: EYE_DIST_SET
.. doxygendefine:: NOSE_EYE_RATIO_THRES_MIN
.. doxygendefine:: NOSE_EYE_RATIO_THRES_MAX
.. doxygendefine:: ENROLL_NAME_LEN

Type Definitions
^^^^^^^^^^^^^^^^

.. doxygentypedef:: face_id_node

