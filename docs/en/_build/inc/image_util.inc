.. File automatically generated by 'gen-dxd.py'

Header File
^^^^^^^^^^^

* :component_file:`esp-face/image_util/include/image_util.h`

Functions
^^^^^^^^^

.. doxygenfunction:: rgb565_to_888
.. doxygenfunction:: rgb565_to_888_q16
.. doxygenfunction:: image_get_width_and_height
.. doxygenfunction:: image_get_area
.. doxygenfunction:: image_calibrate_by_offset
.. doxygenfunction:: image_landmark_calibrate
.. doxygenfunction:: image_rect2sqr
.. doxygenfunction:: rgb888_to_565
.. doxygenfunction:: image_get_valid_boxes
.. doxygenfunction:: image_sort_insert_by_score
.. doxygenfunction:: image_nms_process
.. doxygenfunction:: image_zoom_in_twice
.. doxygenfunction:: image_resize_linear
.. doxygenfunction:: image_cropper
.. doxygenfunction:: image_rgb565_to_888
.. doxygenfunction:: image_rgb888_to_565
.. doxygenfunction:: draw_rectangle_rgb565
.. doxygenfunction:: draw_rectangle_rgb888
.. doxygenfunction:: image_abs_diff
.. doxygenfunction:: image_threshold
.. doxygenfunction:: image_erode
.. doxygenfunction:: matrix_alloc
.. doxygenfunction:: matrix_free
.. doxygenfunction:: get_similarity_matrix
.. doxygenfunction:: get_affine_transform
.. doxygenfunction:: warp_affine
.. doxygenfunction:: image_resize_linear_q
.. doxygenfunction:: image_resize_normalize_quantize
.. doxygenfunction:: image_resize_shift_fast
.. doxygenfunction:: image_resize_nearest_shift
.. doxygenfunction:: image_crop_shift_fast

Structures
^^^^^^^^^^

.. doxygenstruct:: landmark_t
    :members:

.. doxygenstruct:: box_t
    :members:

.. doxygenstruct:: tag_box_list
    :members:

.. doxygenstruct:: tag_image_box
    :members:

.. doxygenstruct:: tag_image_list
    :members:

.. doxygenstruct:: Matrix
    :members:


Macros
^^^^^^

.. doxygendefine:: LANDMARKS_NUM
.. doxygendefine:: MAX_VALID_COUNT_PER_IMAGE
.. doxygendefine:: DL_IMAGE_MIN
.. doxygendefine:: DL_IMAGE_MAX
.. doxygendefine:: RGB565_MASK_RED
.. doxygendefine:: RGB565_MASK_GREEN
.. doxygendefine:: RGB565_MASK_BLUE

Type Definitions
^^^^^^^^^^^^^^^^

.. doxygentypedef:: box_array_t
.. doxygentypedef:: image_box_t
.. doxygentypedef:: image_list_t
.. doxygentypedef:: matrixType

Enumerations
^^^^^^^^^^^^

.. doxygenenum:: en_threshold_mode

