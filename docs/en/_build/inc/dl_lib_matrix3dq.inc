.. File automatically generated by 'gen-dxd.py'

Header File
^^^^^^^^^^^

* :component_file:`esp-face/lib/include/dl_lib_matrix3dq.h`

Functions
^^^^^^^^^

.. doxygenfunction:: dl_matrix3dqq_mobilefaceblock_prelu_split_2_2
.. doxygenfunction:: dl_matrix3dqq_mobilefaceblock_prelu_split_4_4
.. doxygenfunction:: dl_matrix3dqq_mobilefaceblock_prelu_split_1_2
.. doxygenfunction:: dl_matrix3dqq_padding
.. doxygenfunction:: dl_matrix3duq_padding
.. doxygenfunction:: dl_matrix3dq_alloc
.. doxygenfunction:: dl_matrix3dq_free
.. doxygenfunction:: dl_matrix3dq_slice_copy
.. doxygenfunction:: dl_matrix3dq_sliced_transform_nchw
.. doxygenfunction:: dl_matrix3d_from_matrixq
.. doxygenfunction:: dl_matrixq_from_matrix3d_qmf
.. doxygenfunction:: dl_matrixq_from_matrix3d
.. doxygenfunction:: dl_matrix3dq_quant_range_exceeded_checking
.. doxygenfunction:: dl_matrix3dq_shift_exponent
.. doxygenfunction:: dl_matrix3dq_batch_normalize
.. doxygenfunction:: dl_matrix3dq_add
.. doxygenfunction:: dl_matrix3dq_add_channel_diff
.. doxygenfunction:: dl_matrix3dq_relu
.. doxygenfunction:: dl_matrix3dq_relu_clip
.. doxygenfunction:: dl_matrix3dq_leaky_relu
.. doxygenfunction:: dl_matrix3dq_p_relu
.. doxygenfunction:: dl_matrix3dq_concat
.. doxygenfunction:: dl_matrix3dq_concat_4
.. doxygenfunction:: dl_matrix3dq_concat_8
.. doxygenfunction:: dl_matrix3dqq_conv_1x1
.. doxygenfunction:: dl_matrix3dqq_conv_1x1_with_relu
.. doxygenfunction:: dl_matrix3dqq_conv_1x1_with_bias
.. doxygenfunction:: dl_matrix3dqq_conv_1x1_with_bias_relu
.. doxygenfunction:: dl_matrix3dqq_conv_1x1_with_prelu
.. doxygenfunction:: dl_matrix3duq_conv_1x1
.. doxygenfunction:: dl_matrix3duq_conv_1x1_with_bias
.. doxygenfunction:: dl_matrix3dqq_conv_3x3
.. doxygenfunction:: dl_matrix3dqq_conv_3x3_with_bias
.. doxygenfunction:: dl_matrix3dqq_conv_3x3_with_bias_relu
.. doxygenfunction:: dl_matrix3duq_conv_3x3_with_bias
.. doxygenfunction:: dl_matrix3duq_conv_3x3_with_bias_prelu
.. doxygenfunction:: dl_matrix3dqq_conv_3x3_with_bias_prelu
.. doxygenfunction:: dl_matrix3dqq_conv_common
.. doxygenfunction:: dl_matrix3duq_conv_common
.. doxygenfunction:: dl_matrix3duq_depthwise_conv_3x3
.. doxygenfunction:: dl_matrix3dqq_depthwise_conv_3x3
.. doxygenfunction:: dl_matrix3dqq_depthwise_conv_3x3_with_bias
.. doxygenfunction:: dl_matrix3dqq_depthwise_conv_3x3s1_with_bias
.. doxygenfunction:: dl_matrix3dqq_depthwise_conv_3x3_with_prelu
.. doxygenfunction:: dl_matrix3dqq_depthwise_conv_3x3_with_bias_prelu
.. doxygenfunction:: dl_matrix3dqq_global_depthwise_conv_with_bias
.. doxygenfunction:: dl_matrix3dqq_depthwise_conv_2x2
.. doxygenfunction:: dl_matrix3dqq_depthwise_conv_2x2_with_bias
.. doxygenfunction:: dl_matrix3dqq_depthwise_conv_2x2_with_prelu
.. doxygenfunction:: dl_matrix3dqq_depthwise_conv_2x2_with_bias_prelu
.. doxygenfunction:: dl_matrix3dqq_depthwise_conv_5x5
.. doxygenfunction:: dl_matrix3dqq_depthwise_conv_5x5_with_bias
.. doxygenfunction:: dl_matrix3dqq_depthwise_conv_5x5_with_prelu
.. doxygenfunction:: dl_matrix3dqq_depthwise_conv_5x5_with_bias_prelu
.. doxygenfunction:: dl_matrix3dqq_dot_product
.. doxygenfunction:: dl_matrix3dqq_fc
.. doxygenfunction:: dl_matrix3dqq_fc_with_bias
.. doxygenfunction:: dl_matrix3dqq_mobilefaceblock_split
.. doxygenfunction:: dl_matrix3dqq_mobilefaceblock
.. doxygenfunction:: dl_matrix3dqq_mobilefaceblock_prelu
.. doxygenfunction:: dl_matrix3dqq_blazeblock
.. doxygenfunction:: dl_matrix3dqq_double_blazeblock
.. doxygenfunction:: dl_matrix3dqq_mobilenet
.. doxygenfunction:: dl_matrix3duq_mobilenet
.. doxygenfunction:: dl_matrix3dqq_upsample_2x
.. doxygenfunction:: dl_matrix3dq_global_pool
.. doxygenfunction:: dl_matrix3dq_pooling

Structures
^^^^^^^^^^

.. doxygenstruct:: dl_matrix3dq_t
    :members:

.. doxygenstruct:: dl_matrix3dq_mobilenet_config_t
    :members:

.. doxygenstruct:: dl_matrix3dq_blazeblock_config_t
    :members:


Macros
^^^^^^

.. doxygendefine:: DL_QTP_SHIFT
.. doxygendefine:: DL_ITMQ
.. doxygendefine:: DL_QTP_RANGE
.. doxygendefine:: DL_QTP_MAX
.. doxygendefine:: DL_QTP_MIN
.. doxygendefine:: DL_QTP_EXP_NA
.. doxygendefine:: DL_SHIFT_AUTO

Type Definitions
^^^^^^^^^^^^^^^^

.. doxygentypedef:: qtp_t

Enumerations
^^^^^^^^^^^^

.. doxygenenum:: dl_conv_mode

