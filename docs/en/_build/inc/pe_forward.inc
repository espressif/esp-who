.. File automatically generated by 'gen-dxd.py'

Header File
^^^^^^^^^^^

* :component_file:`esp-face/pose_estimation/include/pe_forward.h`

Functions
^^^^^^^^^

.. doxygenfunction:: hd_init_config
.. doxygenfunction:: od_image_sort_insert_by_score
.. doxygenfunction:: od_image_get_valid_boxes
.. doxygenfunction:: od_image_nms_process
.. doxygenfunction:: hand_detection_forward
.. doxygenfunction:: handpose_estimation_forward

Structures
^^^^^^^^^^

.. doxygenstruct:: hd_config_t
    :members:

.. doxygenstruct:: tag_od_box_list
    :members:

.. doxygenstruct:: tag_od_image_box
    :members:

.. doxygenstruct:: tag_od_image_list
    :members:


Macros
^^^^^^

.. doxygendefine:: INPUT_EXPONENT
.. doxygendefine:: SCORE_THRESHOLD
.. doxygendefine:: NMS_THRESHOLD
.. doxygendefine:: HP_TARGET_SIZE

Type Definitions
^^^^^^^^^^^^^^^^

.. doxygentypedef:: od_box_array_t
.. doxygentypedef:: od_image_box_t
.. doxygentypedef:: od_image_list_t

